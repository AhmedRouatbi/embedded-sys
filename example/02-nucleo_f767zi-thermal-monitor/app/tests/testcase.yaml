## example/02-nucleo_f767zi-thermal-monitor/app/tests/testcase.yaml
```yaml
tests:
  thermal.core:
    platform_allow:
      - native_sim/native/64
      - native_sim
    integration_platforms:
      - native_sim/native/64
    tags: unit
```
